## arch/arm/mach-anyka/Kconfig
```kconfig
if ARCH_ANYKA

choice
	prompt "Anyka SoC"
	default TARGET_AK3918EV300

config TARGET_AK3918EV200
	bool "AK3918EV200"
	select AK39_EV200
	help
	  Cloud39E: 64 MiB of DDR2 in the package, boot header AKSH_240.

config TARGET_AK3916EV300
	bool "AK3916EV300"
	select AK39_EV300
	help
	  AnyCloud39EV300, 64 MiB. The AK3916EV301 runs the same image.

config TARGET_AK3918EV300
	bool "AK3918EV300"
	select AK39_EV300
	help
	  AnyCloud39EV300, 64 MiB.

config TARGET_AK3919EV300
	bool "AK3919EV300"
	select AK39_EV300
	help
	  AnyCloud39EV300, 128 MiB.

config TARGET_AK3918EV330
	bool "AK3918EV330"
	select AK39_EV330
	help
	  AnyCloud V500, 64 MiB. The mask ROM loads a first stage into L2
	  memory, which loads U-Boot.

config TARGET_AK3919EV330
	bool "AK3919EV330"
	select AK39_EV330
	help
	  AnyCloud V500, 128 MiB.

config TARGET_AK3918EV300L
	bool "AK3918EV300L"
	select AK39_AV100
	help
	  AnyCloud39EV300L, 64 MiB, boot header AK_H322L. Not an EV300: a
	  24 MHz crystal, a new PLL layout, the SPI controllers at
	  0x21100000, shared pins from 0x178, SD on MCI1. The AK3918EV300W
	  is the same chip.

config TARGET_AK3918AV100
	bool "AK3918AV100"
	select AK39_AV100
	help
	  AnyCloud39AV100: AK3918AV100N, AK3918AV100P and KM01N, 64 MiB,
	  boot header ANYKA322. The EV300L's register map; U-Boot starts at
	  flash offset 0x600, past a secure-boot area the mask ROM copies
	  with it from 0x200 (load address 0x80DFFC00).

config TARGET_AK3918AV100X
	bool "AK3918AV100X"
	select AK39_AV100
	help
	  AnyCloud39AV100: AK3918AV100X, AK3918AV100XP and KM01D, 128 MiB.

endchoice

config AK39_EV200
	bool

config AK39_EV300
	bool

config AK39_EV330
	bool

config AK39_AV100
	bool
	help
	  The AK3918AV100 family (AnyCloud39AV100 and AnyCloud39EV300L): a
	  24 MHz crystal, PLL2 for the peripherals, SPI0 at 0x21100000,
	  shared pins in 3-bit fields from 0x178, SD on MCI1.

config SYS_SOC
	default "anyka"

config SYS_VENDOR
	default "anyka"

config SYS_BOARD
	default "ak39"

config SYS_CONFIG_NAME
	default "anyka"

endif
```

## arch/arm/mach-axera/ax620e/Kconfig
```kconfig
config AXERA_AX620E
	bool "Axera AX620E family"
	select ARM64
	select SYS_ARCH_TIMER
	select DM
	select DM_SERIAL
	select OF_CONTROL
	help
	  Axera's AX620E family (AX620Q, AX630C), Cortex-A53 in AArch64. The
	  vendor's first stage at flash 0 sets up the DDR, unpacks U-Boot's
	  image from flash 0x10000 to 0x5C000400 and starts it there, in EL1.

if AXERA_AX620E

config AXERA_AX630C_EMMC
	bool "AX630C board with eMMC and an SD slot (Sipeed MaixCAM2)"
	help
	  The AX630C with 0.5 to 4 GiB of LPDDR4, its eMMC and SD slot on
	  the Cadence SD4HC controllers and the environment in the eMMC
	  (include/configs/ax630c.h). For now started by the board's stock
	  U-Boot from the SD card. Without it: the AX620Q SPI NOR cameras
	  (include/configs/ax620e.h).

config SYS_SOC
	default "ax620e"

config SYS_BOARD
	default "ax620e"

config SYS_CONFIG_NAME
	default "ax630c" if AXERA_AX630C_EMMC
	default "ax620e"

endif
```

## arch/arm/mach-axera/ax620u/Kconfig
```kconfig
config AXERA_AX620U
	bool "Axera AX620U"
	select CPU_V7A
	select SYS_ARCH_TIMER
	select DM
	select DM_SERIAL
	select OF_CONTROL
	# board_nand_init() makes the SPI NAND nand0
	select SYS_NAND_SELF_INIT if MTD_SPI_NAND && MTD_RAW_NAND
	help
	  Axera AX620U (devicetree "axera,ax620x"): four Cortex-A7 cores
	  in AArch32, a die of its own rather than an AX620E part. The
	  vendor SPL (flash 0, 1 MiB, signed) sets up the DDR and the
	  clocks and loads U-Boot from the boot partition at 0x100000.

if AXERA_AX620U

config SYS_SOC
	default "ax620u"

config SYS_BOARD
	default "ax620u"

config SYS_CONFIG_NAME
	default "ax620u"

endif
```
