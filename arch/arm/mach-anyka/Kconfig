## arch/arm/mach-anyka/Kconfig
```kconfig
if ARCH_ANYKA

choice
	prompt "Anyka SoC"
	default TARGET_AK3918EV300

config TARGET_AK3918EV200
	bool "AK3918EV200"
	select AK39_EV200
	help
	  Cloud39E: 64 MiB of DDR2 in the package, boot header AKSH_240.

config TARGET_AK3916EV300
	bool "AK3916EV300"
	select AK39_EV300
	help
	  AnyCloud39EV300, 64 MiB. The AK3916EV301 runs the same image.

config TARGET_AK3918EV300
	bool "AK3918EV300"
	select AK39_EV300
	help
	  AnyCloud39EV300, 64 MiB.

config TARGET_AK3919EV300
	bool "AK3919EV300"
	select AK39_EV300
	help
	  AnyCloud39EV300, 128 MiB.

config TARGET_AK3918EV330
	bool "AK3918EV330"
	select AK39_EV330
	help
	  AnyCloud V500, 64 MiB. The mask ROM loads a first stage into L2
	  memory, which loads U-Boot.

config TARGET_AK3919EV330
	bool "AK3919EV330"
	select AK39_EV330
	help
	  AnyCloud V500, 128 MiB.

endchoice

config AK39_EV200
	bool

config AK39_EV300
	bool

config AK39_EV330
	bool

config SYS_SOC
	default "anyka"

config SYS_VENDOR
	default "anyka"

config SYS_BOARD
	default "ak39"

config SYS_CONFIG_NAME
	default "anyka"

endif
```

## arch/arm/mach-fullhan/Kconfig
```kconfig
if ARCH_FULLHAN

choice
	prompt "Fullhan SoC"
	default TARGET_FH8852V200

config TARGET_FH8852V200
	bool "FH8852V200 / FH8852V210"
	select FULLHAN_V200
	help
	  FH8852V200: ARM1176 with 64 MiB of DDR2 in the package.

config TARGET_FH8856V200
	bool "FH8856V200 / FH8856V210"
	select FULLHAN_V200
	help
	  FH8856V200: the FH8852V200 die with 128 MiB of DDR in the package.

config TARGET_FH8858V200
	bool "FH8858V200 / FH8858V210"
	select FULLHAN_V200
	help
	  FH8858V200: the FH8852V200 die with 256 MiB of DDR.

config TARGET_FH8652
	bool "FH8652"
	select FULLHAN_865X
	help
	  FH8652: Cortex-A7 with 64 MiB of DDR in the package.

config TARGET_FH8656
	bool "FH8656"
	select FULLHAN_865X
	help
	  FH8656: the FH8652 die with 128 MiB of DDR in the package.

config TARGET_FH8658
	bool "FH8658"
	select FULLHAN_865X
	help
	  FH8658: the FH8652 die with external DDR3.

config TARGET_FH8852V100
	bool "FH8852 (V100)"
	select FULLHAN_V100
	help
	  FH8852: ARM1176 with 64 MiB of DDR2 in the package.

config TARGET_FH8856V100
	bool "FH8856 (V100)"
	select FULLHAN_V100
	help
	  FH8856: the FH8852 die with 128 MiB of DDR in the package.

config TARGET_FH8626V100
	bool "FH8626V100"
	select FULLHAN_8626
	help
	  FH8626V100: ARM1176 with 64 MiB of DDR2 in the package.

config TARGET_FH8632
	bool "FH8632 / FH8632v2 (FH8833)"
	select FULLHAN_8632
	help
	  FH8632: ARM1176 with 64 MiB of DDR2 in the package. Its kernels
	  call the die FH8833.

endchoice

# Generations: what the parts of one die family share. Each target above
# selects one; the code tests these, not the targets.

config FULLHAN_V200
	bool
	select CPU_ARM1176
	help
	  The FH885xV200 generation (FH8852/56/58 V200 and V210), selected by
	  its targets: the register map and set-up its parts share.

config FULLHAN_865X
	bool
	select CPU_V7A
	help
	  The FH865x generation (FH8652/56/58, Cortex-A7), selected by
	  its targets: the register map and set-up its parts share.

config FULLHAN_V100
	bool
	select CPU_ARM1176
	select FH_ATAG_PHYMODE
	help
	  The FH885x V100 generation (FH8852, FH8856), selected by
	  its targets: the register map and set-up its parts share.

config FULLHAN_8626
	bool
	select CPU_ARM1176
	select FH_ATAG_PHYMODE
	help
	  The FH8626V100 generation, selected by
	  its targets: the register map and set-up its parts share.

config FULLHAN_8632
	bool
	select CPU_ARM1176
	select FH_ATAG_PHYMODE
	help
	  The FH8632 generation (FH8632, FH8632v2; the kernels' FH8833), selected by
	  its targets: the register map and set-up its parts share.

config FH_ATAG_PHYMODE
	bool
	help
	  Pass the vendor's PHY mode tag (RMII) to the kernel, which the
	  3.0.8 kernels' Ethernet driver reads.

config FH_DDR_MAX
	hex
	default 0x10000000 if TARGET_FH8858V200 || TARGET_FH8658
	default 0x08000000 if TARGET_FH8856V200 || TARGET_FH8656 || TARGET_FH8856V100
	default 0x04000000
	help
	  The most DDR the part can carry; dram_init() sizes it up to this.

config SYS_SOC
	default "fullhan"

config SYS_VENDOR
	default "fullhan"

config SYS_BOARD
	default "fullhan"

config SYS_CONFIG_NAME
	default "fullhan"

endif
```

## arch/arm/mach-gk710x/Kconfig
```kconfig
if ARCH_GK710X

choice
	prompt "Goke SoC"
	default TARGET_GK7102

config TARGET_GK7101
	bool "GK7101"
	help
	  GK7101: ARM1176 with 128 MiB of external DDR2.

config TARGET_GK7102
	bool "GK7102"
	help
	  GK7102: the GK7101 die with 64 MiB of DDR2 in the package.

config TARGET_GK7101S
	bool "GK7101S"
	select GK710X_S
	help
	  GK7101S: the later GK710xS die, 128 MiB of external DDR2.

config TARGET_GK7102S
	bool "GK7102S / GK7102C"
	select GK710X_S
	help
	  GK7102S, and the GK7102C, a later part of the same family that
	  runs the same HAL: the GK710xS die with 64 MiB of DDR2 in the
	  package.

endchoice

config GK710X_S
	bool
	select MMC_SDHCI_IO_ACCESSORS if MMC_SDHCI
	help
	  The GK710xS die: its blocks sit at the addresses the vendor
	  drivers use, in their register layout, instead of being moved and
	  reordered behind the HAL as on the GK7101/GK7102.

config SYS_SOC
	default "gk710x"

config SYS_VENDOR
	default "goke"

config SYS_BOARD
	default "gk710x"

config SYS_CONFIG_NAME
	default "gk710x"

endif
```

## arch/arm/mach-novatek/Kconfig
```kconfig
if ARCH_NOVATEK

choice
	prompt "Novatek SoC"
	default TARGET_NT98562

config TARGET_NT98560
	bool "NT98560"
	select NVT_NA51089
	help
	  NA51089 with external DDR3, 512 MiB on the SDK's board.

config TARGET_NT98561
	bool "NT98561"
	select NVT_NA51089
	help
	  NA51089 with 64 MiB of DDR2 in the package, as the NT98562.

config TARGET_NT98562
	bool "NT98562"
	select NVT_NA51089
	help
	  NA51089 with 64 MiB of DDR2 in the package.

config TARGET_NT98566
	bool "NT98566"
	select NVT_NA51089
	help
	  NA51089 with 128 MiB of DDR3 in the package.

config TARGET_NT98520
	bool "NT98520"
	select NVT_NA51055
	help
	  NA51055 (two Cortex-A9s) with external DDR3, one die, 512 MiB
	  as the loader is built.

config TARGET_NT98522
	bool "NT98522"
	select NVT_NA51055
	help
	  NA51055 with 64 MiB of DDR in the package.

config TARGET_NT98523
	bool "NT98523"
	select NVT_NA51055
	help
	  NA51055 with 128 MiB of DDR in the package.

config TARGET_NT98525
	bool "NT98525"
	select NVT_NA51055
	help
	  NA51055 with two external DDR3 dies, 512 MiB each on the SDK's
	  board; U-Boot uses the first.

config TARGET_NT98528
	bool "NT98528"
	select NVT_NA51055
	help
	  NA51084 (two Cortex-A9s, the NT9852x SDK's other die) with two
	  external DDR3 dies, 512 MiB each on the SDK's board.

config TARGET_NT98529
	bool "NT98529"
	select NVT_NA51055
	help
	  NA51084 as the NT98528, its CPU cleared for 1.2 GHz.

config TARGET_NT98332
	bool "NT98332 (NA51103)"
	select NVT_NA51103
	help
	  NA51103, the NVR die with two Cortex-A53s, 1 GiB of DDR on the
	  boards. U-Boot runs in AArch64 at EL2, started by the board's
	  BL31.

config TARGET_NT98633
	bool "NT98633 (NA51090)"
	select NVT_NA51090
	help
	  NA51090, the NVR die with four Cortex-A53s, 2 GiB of DDR on the
	  boards. U-Boot runs in AArch64 at EL2, started by the board's
	  BL31.

config TARGET_NT98321
	bool "NT98321"
	select NVT_NA51068
	help
	  NA51068 (DVR/NVR, two Cortex-A9s) with external DDR3, 512 MiB on
	  the SDK's board, booting from SPI NOR.

config TARGET_NT98323
	bool "NT98323"
	select NVT_NA51068
	help
	  NA51068 (DVR/NVR, two Cortex-A9s) with external DDR4, 512 MiB on
	  the SDK's NOR board.

endchoice

config NVT_NA51089
	bool

config NVT_NA51055
	bool
	help
	  The NT9852x SDK's dies, NA51055 and NA51084: NA51089's blocks at
	  NA51089's addresses, two Cortex-A9s, their own loader
	  (board/novatek/na51055/loader). The chip ID tells them apart.

# The NVR dies: the board's loader warm-resets the A53s into AArch64 and
# its BL31 (TF-A v2.2) enters U-Boot at EL2 with a fixed SPSR (0x3C9), so
# U-Boot is an AArch64 one.
config NVT_NA511XX
	bool
	select ARM64

config NVT_NA51103
	bool
	select NVT_NA511XX

config NVT_NA51090
	bool
	select NVT_NA511XX

config NVT_NA51068
	bool

config NVT_DDR_SIZE
	hex
	default 0x80000000 if TARGET_NT98633
	default 0x40000000 if TARGET_NT98332
	default 0x20000000 if TARGET_NT98560 || NVT_NA51068
	default 0x08000000 if TARGET_NT98566
	default 0x20000000 if TARGET_NT98520 || TARGET_NT98525
	default 0x20000000 if TARGET_NT98528 || TARGET_NT98529
	default 0x08000000 if TARGET_NT98523
	default 0x04000000
	help
	  The DDR at 0: the package's, or the board's for a part with
	  external DDR, as its loader is built. A second DDR die (at
	  0x40000000 on NA51055 / NA51084) is the media pool's alone. On NA51068
	  the loader's device tree (/nvt_memory_cfg/dram) says it; this is
	  the fallback.

config NVT_OSMEM
	string
	default "0x57600000" if NVT_NA51090
	default "0x15e00000" if NVT_NA51103
	default "160M" if TARGET_NT98321
	default "192M" if TARGET_NT98323
	default "256M" if NVT_DDR_SIZE >= 0x20000000
	default "64M" if TARGET_NT98523
	default "32M"
	help
	  What Linux gets of the DDR by default (osmem, mem=); the vendor
	  media modules get the rest. 32M is what OpenIPC's install guide
	  sets on the NT98562/566's vendor U-Boot; larger parts give Linux
	  what their SDK board does (the NT98523's tree keeps its CMA at
	  48 MiB), the NVRs what their firmware sets (Xiongmai's NT98332
	  NVR 0x15e00000, the NT98633 NVR's tree 0x57600000).

config SYS_SOC
	default "novatek"

config SYS_VENDOR
	default "novatek"

config SYS_BOARD
	default "na511xx" if NVT_NA511XX
	default "na51068" if NVT_NA51068
	default "na51089"

config SYS_CONFIG_NAME
	default "novatek"

endif
```

## arch/arm/mach-sigmastar/Kconfig
```kconfig
if ARCH_SIGMASTAR

choice
	prompt "SigmaStar SoC"
	default TARGET_MSC313E

config TARGET_MSC313E
	bool "MSC313E"
	select SS_INFINITY3
	help
	  infinity3, QFN, 64 MiB of DDR2 in the package.

config TARGET_MSC316DC
	bool "MSC316DC"
	select SS_INFINITY3
	help
	  infinity3, QFN, 128 MiB of DDR in the package (the SDK's
	  QFN128MDC board).

config TARGET_MSC316DM
	bool "MSC316DM"
	select SS_INFINITY3
	help
	  infinity3, QFN, 128 MiB of DDR in the package (the SDK's QFN128M
	  board).

config TARGET_SSC325
	bool "SSC325"
	select SS_INFINITY6
	help
	  infinity6. The IPL sets up the DDR; dram_init() reads its size
	  from the MIU.

config TARGET_SSC325DE
	bool "SSC325DE"
	select SS_INFINITY6
	help
	  infinity6, as the SSC325. OpenIPC ships it on SPI NAND.

config TARGET_SSC327DE
	bool "SSC327DE"
	select SS_INFINITY6
	help
	  infinity6, as the SSC325.

config TARGET_SSR621Q
	bool "SSR621Q"
	select SS_INFINITY2M
	help
	  infinity2m with 256 MiB of DDR, on Xiongmai's NVRs.

config TARGET_SSC375
	bool "SSC375"
	select SS_IFADO
	help
	  Ifado (SSC032B), QFN88 with 128 MiB of DDR3, in Dahua cameras.
	  The infinity2m map with infinity6c's FSP-QSPI.

config TARGET_SSC029A
	bool "SSC029A"
	select SS_IFORD
	help
	  Iford, BGA with 512 MiB of DDR4.

config TARGET_SSC029B
	bool "SSC029B"
	select SS_IFORD
	help
	  Iford, BGA with 256 MiB of DDR3.

config TARGET_SSC029C
	bool "SSC029C"
	select SS_IFORD
	help
	  Iford, QFN128 with 128 MiB of DDR3.

config TARGET_SSC034A
	bool "SSC034A"
	select SS_IFLIEGEN
	help
	  Ifliegen, QFN128 with 128 MiB of DDR3.

config TARGET_SSC034B
	bool "SSC034B"
	select SS_IFLIEGEN
	help
	  Ifliegen, QFN88 with 64 MiB of DDR3.

config TARGET_SSC333
	bool "SSC333"
	select SS_INFINITY6B0
	help
	  infinity6b0. The IPL sets up the DDR; dram_init() reads its size
	  from the MIU.

config TARGET_SSC335
	bool "SSC335"
	select SS_INFINITY6B0
	help
	  infinity6b0. The IPL sets up the DDR; dram_init() reads its size
	  from the MIU.

config TARGET_SSC335DE
	bool "SSC335DE"
	select SS_INFINITY6B0
	help
	  infinity6b0. The IPL sets up the DDR; dram_init() reads its size
	  from the MIU.

config TARGET_SSC337
	bool "SSC337"
	select SS_INFINITY6B0
	help
	  infinity6b0. The IPL sets up the DDR; dram_init() reads its size
	  from the MIU.

config TARGET_SSC337DE
	bool "SSC337DE"
	select SS_INFINITY6B0
	help
	  infinity6b0. The IPL sets up the DDR; dram_init() reads its size
	  from the MIU.

config TARGET_SSC30KD
	bool "SSC30KD"
	select SS_INFINITY6E
	help
	  infinity6e. The IPL sets up the DDR; dram_init() reads its size
	  from the MIU.

config TARGET_SSC30KQ
	bool "SSC30KQ"
	select SS_INFINITY6E
	help
	  infinity6e. The IPL sets up the DDR; dram_init() reads its size
	  from the MIU.

config TARGET_SSC338Q
	bool "SSC338Q"
	select SS_INFINITY6E
	help
	  infinity6e. The IPL sets up the DDR; dram_init() reads its size
	  from the MIU.

config TARGET_SSC377
	bool "SSC377"
	select SS_INFINITY6C
	help
	  infinity6c. The IPL sets up the DDR; dram_init() reads its size
	  from the MIU.

config TARGET_SSC377D
	bool "SSC377D"
	select SS_INFINITY6C
	help
	  infinity6c. The IPL sets up the DDR; dram_init() reads its size
	  from the MIU.

config TARGET_SSC377DE
	bool "SSC377DE"
	select SS_INFINITY6C
	help
	  infinity6c. The IPL sets up the DDR; dram_init() reads its size
	  from the MIU.

config TARGET_SSC377QE
	bool "SSC377QE"
	select SS_INFINITY6C
	help
	  infinity6c. The IPL sets up the DDR; dram_init() reads its size
	  from the MIU.

config TARGET_SSC378DE
	bool "SSC378DE"
	select SS_INFINITY6C
	help
	  infinity6c. The IPL sets up the DDR; dram_init() reads its size
	  from the MIU.

config TARGET_SSC378QE
	bool "SSC378QE"
	select SS_INFINITY6C
	help
	  infinity6c. The IPL sets up the DDR; dram_init() reads its size
	  from the MIU.

config TARGET_SSD201
	bool "SSD201"
	select SS_INFINITY2M
	help
	  infinity2m, 64 MiB of DDR in the package.

config TARGET_SSD202D
	bool "SSD202D"
	select SS_INFINITY2M
	help
	  infinity2m, 128 MiB of DDR in the package.

endchoice

config SS_INFINITY3
	bool

config SS_INFINITY2M
	bool

config SS_INFINITY6
	bool

config SS_INFINITY6B0
	bool

config SS_INFINITY6E
	bool

config SS_INFINITY6C
	bool

config SS_IFORD
	bool

config SS_IFADO
	bool

config SS_IFLIEGEN
	bool

# Iford and Ifliegen: the FSP at 0x100D, BDMA from MIU by channel 1, no MIU
# write pipe to flush
config SS_IFORD_FAMILY
	def_bool SS_IFORD || SS_IFLIEGEN

# What infinity6c, Iford and Ifliegen share: the boot flash's chip select in
# software, the Ethernet PHY at bank 0x1518 (and, but on Ifliegen, the DDR
# size in bank 0x1659)
config SS_I6C_FAMILY
	def_bool SS_INFINITY6C || SS_IFORD || SS_IFLIEGEN

# The FSP-QSPI whose chip select the boot flash's driver holds in software
config SS_FSP_SW_CS
	def_bool SS_I6C_FAMILY || SS_IFADO

# The dies booted with OpenIPC's LX_MEM/mma_heap arguments, whose values
# depend on the DDR size
config SS_MMA_BOOTARGS
	def_bool SS_INFINITY2M || SS_INFINITY6 || SS_INFINITY6B0 || SS_INFINITY6E || SS_I6C_FAMILY || SS_IFADO

config SYS_SOC
	default "sigmastar"

config SYS_VENDOR
	default "sigmastar"

config SYS_BOARD
	default "ipc"

config SYS_CONFIG_NAME
	default "sigmastar"

endif
```
