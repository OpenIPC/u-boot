## arch/arm/mach-xm/Kconfig
```kconfig
if ARCH_XM

choice
	prompt "Xiongmai SoC"
	default TARGET_XM510

config TARGET_XM510
	bool "XM510"
	help
	  XM510: one Cortex-A5 class core, 32 or 64 MiB DDR2, flash
	  controller v1 with its read window at 0x0.

config TARGET_XM530
	bool "XM530"
	select XM_SFC_V2
	help
	  XM530: 64 MiB DDR2, flash controller v2 with its read window at
	  0x60000000, also mapped at 0x08000000 where U-Boot runs.

config TARGET_XM550
	bool "XM550"
	select XM_SFC_V2
	select XM_DDR3
	help
	  XM550: the XM530 die with 128 MiB of DDR3 and a 1600M DDR PLL.
	  It uses the XM530 board and flash controller, so one U-Boot
	  board serves both.

config TARGET_XM530V200
	bool "XM530V200"
	select XM_SFC_V2
	select XM_V200
	select XM_DDR3
	help
	  XM530V200 (its U-Boot says XM550V200WX2): two cores, 128 MiB of
	  DDR3 on a DesignWare uMCTL2. U-Boot runs in place from the v2
	  read window at 0x60000000.

config TARGET_XM533
	bool "XM533"
	select XM_SFC_V2
	select XM_V200
	help
	  XM533 ("qiandaohu", xm530v300 in its modules): 64 MiB of DDR2 on
	  a DesignWare uMCTL2, its SD slot on the second SDIO controller.

config TARGET_XM535
	bool "XM535"
	select XM_SFC_V2
	select XM_V200
	help
	  XM535D1, XM535D2 and XM535W1 (pick one under "XM535 chip"): DDR2
	  on the 64 MiB D1 and W1, DDR3 on the 128 MiB D2, on a DesignWare
	  uMCTL2.

endchoice

config XM_SFC_V2
	bool

config XM_V200
	bool
	help
	  The V200 series (XM530V200, XM533, XM535): a DesignWare uMCTL2 for DDR, a
	  24 MHz reference clock, and U-Boot linked at the flash window.

config XM_DDR3
	bool

choice
	prompt "XM535 chip"
	depends on TARGET_XM535
	default XM535D1
	help
	  Xiongmai ships one U-Boot per XM535 chip; nothing probes which
	  one, or which DDR, is fitted.

config XM535D1
	bool "XM535D1: 64 MiB DDR2-1333"

config XM535D2
	bool "XM535D2: 128 MiB DDR3-1866"
	select XM_DDR3

config XM535W1
	bool "XM535W1: 64 MiB DDR2-1066"

endchoice

config XM_DDR_64M
	bool "64 MiB DDR2 (XM510)"
	depends on TARGET_XM510
	help
	  The XM510's 64 MiB option: other PLL D settings and DDR training
	  values than the 32 MiB part.

config SYS_SOC
	default "xm"

config SYS_VENDOR
	default "xiongmai"

config SYS_BOARD
	default "xm510" if TARGET_XM510
	default "xm530"

config SYS_CONFIG_NAME
	default "xm510" if TARGET_XM510
	default "xm530"

endif
```

## arch/mips/mach-ingenic/Kconfig
```kconfig
menu "Ingenic T-series camera SoCs"
	depends on ARCH_INGENIC

config SYS_SOC
	default "t10" if T10
	default "t20" if T20
	default "t21" if T21
	default "t23" if T23
	default "t30" if T30
	default "t31" if T31
	default "t40" if T40
	default "t41" if T41

config SYS_VENDOR
	default "ingenic"

config SYS_BOARD
	default "isvp"

config SYS_CONFIG_NAME
	default "ingenic-isvp"

choice
	prompt "SoC"

config T10
	bool "T10"
	help
	  Ingenic T10 (XBurst, DWC DDR PHY).

config T20
	bool "T20"
	help
	  Ingenic T20 (XBurst, DWC DDR PHY).

config T21
	bool "T21"
	help
	  Ingenic T21 (XBurst, Innophy DDR PHY, internal Ethernet PHY).

config T23
	bool "T23"
	help
	  Ingenic T23 (XBurst, Innophy DDR PHY).

config T30
	bool "T30"
	help
	  Ingenic T30 (XBurst, Innophy DDR PHY).

config T31
	bool "T31"
	help
	  Ingenic T31 (XBurst, Innophy DDR PHY).

config T40
	bool "T40"
	select CPU_XBURST2
	help
	  Ingenic T40 (XBurst2 with L2 cache, Innophy DDR PHY, SDHCI, the
	  SFC of the second generation).

config T41
	bool "T41"
	select CPU_XBURST2
	help
	  Ingenic T41 (XBurst2 with L2 cache, Innophy DDR PHY of the second
	  DDR generation, SDHCI, two SFCs).

endchoice

# The package variants. Each selects what the vendor's boards.cfg option
# of the same name selected: the PLL and DDR frequencies and the DDR chip.

config LITE_VERSION
	bool "Lite package (lower CPU and DDR clocks)"
	depends on T10 || T20 || T30 || T31

config DDR2_128M
	bool "128 MiB DDR2 in the package"
	depends on T20 || T21 || T30 || T31

config DDR3_128M
	bool "128 MiB DDR3 in the package"
	depends on T30 || T31

config T23N
	bool "T23N"
	depends on T23
	help
	  64 MiB DDR2 in the package.

config T23ZN
	bool "T23ZN"
	depends on T23
	select T23N
	help
	  Set up as the T23N, as the vendor SDK does; its SPL tells the
	  two apart only by the chip ID it prints.

config T23X
	bool "T23X"
	depends on T23 && !T23N
	help
	  128 MiB DDR2 in the package.

config T30A
	bool "T30A"
	depends on T30

config T31A
	bool "T31A"
	depends on T31

config T31AL
	bool "T31AL"
	depends on T31

config T31LC
	bool "T31LC"
	depends on T31

config T40N
	bool "T40N"
	depends on T40
	help
	  128 MiB DDR2 in the package.

config T40XP
	bool "T40XP"
	depends on T40
	help
	  DDR3 in the package (M15T1G1664A).

config T40A
	bool "T40A"
	depends on T40
	help
	  DDR3 in the package (M15T4G16256A).

config T41L
	bool "T41L"
	depends on T41
	help
	  64 MiB DDR2 in the package (M14D5121632A).

config T41LQ
	bool "T41LQ"
	depends on T41
	help
	  The T41L's DDR (64 MiB DDR2) and clocks.

config T41N
	bool "T41N"
	depends on T41
	help
	  128 MiB DDR3 in the package (W631GU6NG).

config T41NQ
	bool "T41NQ"
	depends on T41
	help
	  128 MiB DDR3 (W631GU6NG), DDR at 700 MHz.

config T41A
	bool "T41A"
	depends on T41
	help
	  DDR3 W631GU6NG, CPU at 1300 MHz and DDR at 800 MHz.

config T41ZX
	bool "T41ZX"
	depends on T41
	help
	  256 MiB DDR3 in the package (W632GU6NG).

config T41XQ
	bool "T41XQ"
	depends on T41
	help
	  256 MiB DDR3 in the package (W632GU6NG).

# What the vendor's per-SoC headers hard-code

config CPU_XBURST2
	bool
	help
	  An XBurst2 CPU core: the T40 and T41, with an L2 cache.

config CPU_XBURST
	def_bool y if !CPU_XBURST2
	help
	  An XBurst CPU core, as the vendor code names it.

config DDR_PARAMS_CREATOR
	def_bool y
	help
	  The DDR register values come from ddr_params_creator.

config DDR_HOST_CC
	def_bool y
	help
	  ddr_params_creator runs on the build host, not in the SPL.

config DDR_INNOPHY
	def_bool y if T21 || T23 || T30 || T31 || T40 || T41
	help
	  The Innosilicon DDR PHY; the T10 and T20 have the DesignWare one.

config SPL_DDR_SOFT_TRAINING
	def_bool y if !T23 && !CPU_XBURST2
	help
	  The software DQS training of the vendor SPL (ddr_dqs_training.c).

config DDR_TYPE_DDR2
	def_bool y if !DDR_TYPE_DDR3

config DDR_TYPE_DDR3
	def_bool y if DDR3_128M || (T23 && !T23N && !T23X) || T40XP || T40A || \
		     (T41 && !T41L && !T41LQ)

config DDR2_M14D5121632A
	def_bool y if DDR_TYPE_DDR2 && !DDR2_128M && !T23X

config DDR2_M14D1G1664A
	def_bool y if DDR2_128M || T23X

config DDR3_M15T1G1664A_2C
	def_bool y if DDR3_128M || T40XP

config DDR3_M15T4G16256A_2S
	def_bool y if T40A

config DDR3_W631GU6NG
	def_bool y if T41N || T41NQ || T41A

config DDR3_W632GU6NG
	def_bool y if T41ZX || T41XQ

config DDR3_TSD34096M1333C9_E
	def_bool y if T23 && !T23N && !T23X

config JZ_MMC_MSC0
	def_bool y
	help
	  MSC0 on port B: the SD card slot of the cameras.

config SFC_NOR
	def_bool y
	help
	  Boot from SPI NOR on the SFC.

config NET_GMAC
	def_bool y
	help
	  The SoC GMAC: its clock is ungated in the SPL, as the vendor does.

config INGENIC_SPL_PAD_TO
	hex
	default 0x6800
	help
	  The SPL slot at the start of the flash; the LZO-packed U-Boot
	  follows it.

endmenu
```

## board/hisilicon/hi3516av100/Kconfig
```kconfig
if TARGET_HI3516AV100 || TARGET_HI3516DV100

config SYS_BOARD
	default "hi3516av100"

config SYS_VENDOR
	default "hisilicon"

config SYS_SOC
	default "hi3516a"

config SYS_CONFIG_NAME
	default "hi3516av100" if TARGET_HI3516AV100
	default "hi3516dv100" if TARGET_HI3516DV100

endif
```

## board/hisilicon/hi3516av200/Kconfig
```kconfig
if TARGET_HI3516AV200

config SYS_BOARD
	default "hi3516av200"

config SYS_VENDOR
	default "hisilicon"

config SYS_SOC
	default "hi3516av200"

config SYS_CONFIG_NAME
	default "hi3516av200"

endif
```

## board/hisilicon/hi3516cv300/Kconfig
```kconfig
if TARGET_HI3516CV300 || TARGET_HI3516EV100

config SYS_BOARD
	default "hi3516cv300"

config SYS_VENDOR
	default "hisilicon"

config SYS_SOC
	default "hi3516cv300"

config SYS_CONFIG_NAME
	default "hi3516cv300" if TARGET_HI3516CV300
	default "hi3516ev100" if TARGET_HI3516EV100

endif
```

## board/hisilicon/hi3518ev100/Kconfig
```kconfig
if TARGET_HI3518AV100 || TARGET_HI3518CV100 || TARGET_HI3518EV100 || TARGET_HI3516CV100

config SYS_BOARD
	default "hi3518ev100"

config SYS_VENDOR
	default "hisilicon"

config SYS_SOC
	default "hi3518ev100"

config SYS_CONFIG_NAME
	default "hi3518av100" if TARGET_HI3518AV100
	default "hi3518cv100" if TARGET_HI3518CV100
	default "hi3518ev100" if TARGET_HI3518EV100
	default "hi3516cv100" if TARGET_HI3516CV100

endif
```

## board/hisilicon/hi3518ev200/Kconfig
```kconfig
if TARGET_HI3516CV200 || TARGET_HI3518EV200

config SYS_BOARD
	default "hi3518ev200"

config SYS_VENDOR
	default "hisilicon"

config SYS_SOC
	default "hi3518ev200"

config SYS_CONFIG_NAME
	default "hi3516cv200" if TARGET_HI3516CV200
	default "hi3518ev200" if TARGET_HI3518EV200

endif
```

## board/hisilicon/hi3519v101/Kconfig
```kconfig
if TARGET_HI3519V101

config SYS_BOARD
	default "hi3519v101"

config SYS_VENDOR
	default "hisilicon"

config SYS_SOC
	default "hi3519v101"

config SYS_CONFIG_NAME
	default "hi3519v101"

endif
```

## board/hisilicon/hi3520dv100/Kconfig
```kconfig
if TARGET_HI3515AV100 || TARGET_HI3520AV100 || TARGET_HI3520DV100 || TARGET_HI3520DV200

config SYS_BOARD
	default "hi3520dv100"

config SYS_VENDOR
	default "hisilicon"

config SYS_SOC
	default "hi3520d"

config SYS_CONFIG_NAME
	default "hi3520dv100"

endif
```

## board/hisilicon/hi3536c/Kconfig
```kconfig
if TARGET_HI3536CV100

config SYS_BOARD
	default "hi3536c"

config SYS_VENDOR
	default "hisilicon"

config SYS_SOC
	default "hi3536c"

config SYS_CONFIG_NAME
	default "hi3536cv100"

endif
```

## board/hisilicon/hi3536dv100/Kconfig
```kconfig
if TARGET_HI3536DV100

config SYS_BOARD
	default "hi3536dv100"

config SYS_VENDOR
	default "hisilicon"

config SYS_SOC
	default "hi3536dv100"

config SYS_CONFIG_NAME
	default "hi3536dv100"

endif
```

## configs/hi3516cv500_defconfig
```kconfig
CONFIG_SYS_LOAD_ADDR=0x82080000
CONFIG_ARM=y
CONFIG_TARGET_HI3516CV500=y
CONFIG_SYS_TEXT_BASE=0x80800000
CONFIG_SYS_MALLOC_F_LEN=0x2000
CONFIG_ENV_SIZE=0x10000
CONFIG_ENV_OFFSET=0x40000
CONFIG_NR_DRAM_BANKS=1
CONFIG_ENV_SECT_SIZE=0x10000
CONFIG_IDENT_STRING="hi3516cv500"
CONFIG_BOOTSTAGE_STASH_SIZE=4096
CONFIG_BOOTDELAY=1
CONFIG_KERNEL_LOAD_ADDR=0x82000000
# CONFIG_DISPLAY_CPUINFO is not set
# CONFIG_DISPLAY_BOARDINFO is not set
CONFIG_HUSH_PARSER=y
CONFIG_SYS_PROMPT="OpenIPC # "
# CONFIG_BOOTM_NETBSD is not set
# CONFIG_BOOTM_PLAN9 is not set
# CONFIG_BOOTM_RTEMS is not set
# CONFIG_BOOTM_VXWORKS is not set
# CONFIG_CMD_ELF is not set
# CONFIG_CMD_IMI is not set
# CONFIG_CMD_XIMG is not set
CONFIG_CMD_LZMADEC=y
CONFIG_CMD_UNZIP=y
CONFIG_CMD_CREAD=y
CONFIG_CMD_UGZIP=y
# CONFIG_CMD_FLASH is not set
CONFIG_CMD_SF=y
# CONFIG_CMD_ECHO is not set
# CONFIG_CMD_ITEST is not set
# CONFIG_CMD_SOURCE is not set
# CONFIG_CMD_SETEXPR is not set
CONFIG_CMD_DHCP=y
CONFIG_CMD_TFTPPUT=y
# CONFIG_CMD_NFS is not set
CONFIG_CMD_MII=y
CONFIG_CMD_PING=y
CONFIG_CMD_CACHE=y
CONFIG_CMD_FAT=y
CONFIG_ENV_IS_IN_SPI_FLASH=y
CONFIG_NET_RANDOM_ETHADDR=y
CONFIG_HAVE_BLOCK_DEVICE=y
CONFIG_DDR_TRAINING_V2=y
# CONFIG_INPUT is not set
# CONFIG_MMC is not set
CONFIG_MTD=y
CONFIG_FMC=y
CONFIG_FMC_SPI_NOR=y
CONFIG_SPI_BLOCK_PROTECT=y
CONFIG_MII=y
CONFIG_NET_HISFV300=y
CONFIG_CONS_INDEX=0
CONFIG_PL011_SERIAL=y
CONFIG_USB=y
CONFIG_USB_XHCI_HCD=y
CONFIG_USB_STORAGE=y
# CONFIG_USE_PRIVATE_LIBGCC is not set
CONFIG_NETDEVICES=y
CONFIG_SKIP_LOWLEVEL_INIT=y
CONFIG_ENV_SPI_BUS=0
CONFIG_ENV_SPI_CS=0
CONFIG_ENV_SPI_MAX_HZ=1000000
CONFIG_ENV_SPI_MODE=3
CONFIG_CMD_MISC=y
CONFIG_PHY_HISI_USB=y
CONFIG_CMD_USB=y
# CONFIG_DM_USB is not set
CONFIG_PHY=y
```

## configs/hi3516cv610_openipc_defconfig
```kconfig
CONFIG_ARM=y
CONFIG_SKIP_LOWLEVEL_INIT=y
# CONFIG_ARM_SMCCC is not set
CONFIG_SYS_THUMB_BUILD=y
# CONFIG_USE_ARCH_MEMCPY is not set
# CONFIG_USE_ARCH_MEMSET is not set
CONFIG_ARCH_BSP=y
CONFIG_SYS_TEXT_BASE=0x41800000
CONFIG_NR_DRAM_BANKS=1
CONFIG_ENV_SIZE=0x10000
CONFIG_ENV_OFFSET=0x40000
CONFIG_ENV_SECT_SIZE=0x10000
CONFIG_IDENT_STRING="hi3516cv610"
CONFIG_TARGET_HI3516CV610=y
CONFIG_VENDER_UBOOT_NAME="hi3516cv610"
CONFIG_SYS_LOAD_ADDR=0x42080000
CONFIG_FIT=y
CONFIG_BOOTSTAGE_STASH_SIZE=4096
# CONFIG_USE_BOOTARGS=y
CONFIG_BOOTARGS_SUBST=y
# CONFIG_DISPLAY_CPUINFO is not set
# CONFIG_DISPLAY_BOARDINFO is not set
CONFIG_HUSH_PARSER=y
CONFIG_SYS_PROMPT="OpenIPC # "
# CONFIG_CMD_ELF is not set
# CONFIG_CMD_FDT is not set
# CONFIG_CMD_IMI is not set
# CONFIG_CMD_XIMG is not set
# CONFIG_CMD_DDR_TRAINING is not set
# CONFIG_CMD_FLASH is not set
# CONFIG_CMD_USB is not set
CONFIG_CMD_ECHO=y
CONFIG_CMD_ITEST=y
CONFIG_CMD_SOURCE=y
CONFIG_CMD_SETEXPR=y
CONFIG_CMD_DHCP=y
CONFIG_CMD_MII=y
CONFIG_CMD_PING=y
CONFIG_CMD_CACHE=y
CONFIG_CMD_SMC=y
# CONFIG_CMD_IPCBOOT is not set
CONFIG_DOS_PARTITION=y
# CONFIG_ENV_IS_IN_NAND is not set
CONFIG_ENV_IS_IN_SPI_FLASH=y
CONFIG_ENV_SPI_BUS=0
CONFIG_ENV_SPI_CS=0
CONFIG_ENV_SPI_MAX_HZ=1000000
CONFIG_ENV_SPI_MODE=3
CONFIG_HAVE_BLOCK_DEVICE=y
CONFIG_NET=y
CONFIG_MMC=y
CONFIG_MTD=y
CONFIG_FMC=y
# CONFIG_MTD_RAW_NAND is not set
# CONFIG_FMC_SPI_NAND is not set
CONFIG_FMC_SPI_NOR=y
CONFIG_SPI_BLOCK_PROTECT=y
CONFIG_SFV300_ETH=y
# CONFIG_PHY_USB is not set
# CONFIG_POWER is not set
CONFIG_CONS_INDEX=0
CONFIG_PL011_SERIAL=y
# CONFIG_USB is not set
# CONFIG_USB_XHCI_HCD is not set
# CONFIG_USB_STORAGE is not set
# CONFIG_USB_GADGET is not set
CONFIG_FS_FAT=y
# CONFIG_GZIP is not set
CONFIG_HWDEC_V1=y
CONFIG_OF_LIBFDT=y
CONFIG_BOOTDELAY=1
CONFIG_BSP_DISABLE_DOWNLOAD=y
CONFIG_CMD_NET=y
# CONFIG_CMD_BOOTP is not set
# CONFIG_CMD_PCAP is not set
CONFIG_CMD_TFTPBOOT=y
CONFIG_CMD_TFTPPUT=y
# CONFIG_CMD_TFTPSRV is not set
CONFIG_NET_TFTP_VARS=y
# CONFIG_CMD_RARP is not set
# CONFIG_CMD_NFS is not set
CONFIG_NET_RANDOM_ETHADDR=y
CONFIG_ENV_IS_IN_SPI_FLASH=y
# CONFIG_DELAY_ENVIRONMENT is not set
# CONFIG_ENV_IS_IN_NAND is not set
# CONFIG_BOOTM_NETBSD is not set
# CONFIG_BOOTM_OPENRTOS is not set
# CONFIG_BOOTM_OSE is not set
# CONFIG_BOOTM_PLAN9 is not set
# CONFIG_BOOTM_RTEMS is not set
# CONFIG_BOOTM_VXWORKS is not set
CONFIG_CMD_LOADB=y
CONFIG_VERSION_VARIABLE=y
```
