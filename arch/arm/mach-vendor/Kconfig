## arch/arm/mach-vendor/Kconfig
```kconfig
if ARCH_BSP

config TARGET_HI3516CV610
	bool "Support HI3516CV610"
	select TARGET_HI3516CV610_FAMILY
	help
	  Support for HI3516CV610 platform.

config TARGET_HI3516CV608
	bool "Support HI3516CV608"
	select TARGET_HI3516CV610_FAMILY
	help
	  Support for HI3516CV608 platform.

config TARGET_HI3519DV500
	bool "Support HI3519DV500"
	select ARM64
	select DM
	select TARGET_HI3519DV500_FAMILY
	help
	  Support for HI3519DV500 platform.

config TARGET_HI3516DV500
	bool "Support HI3516DV500"
	select ARM64
	select DM
	select TARGET_HI3519DV500_FAMILY
	help
	  Support for HI3516DV500 platform.

config TARGET_HI3516CV610_FAMILY
	bool "Support HI3516CV610 FAMILY"
	select CPU_V7A
	help
	  Support for HI3516CV610 FAMILY.

config TARGET_HI3519DV500_FAMILY
	bool "Support HI3519DV500 FAMILY"
	select ARM64
	select DM
	help
	  Support for HI3519DV500 FAMILY.

config VENDER_UBOOT_NAME
	string "Final name of u-boot.bin"

config FDT_LOAD_ADDR
	hex "Address at which to load devicetree"
	default "0x40000000"

menu "vendor_setup"

config VENDOR_MC
	bool "mc platform solution"
	default n
	help
	  support for mc platform solution

config VENDOR_SPIFLASH_SPEED
	bool "spinor and spinand  speed "
	default n
	depends on FMC_SPI_NAND || FMC_SPI_NOR || FMC_NAND
	help
	  Support for flash speed  testing.

config VENDOR_UPGRADE_BY_SEGMENT
	bool "Upgrade by segment write"
	default n
	help
	  Support for upgrade by segment,this option is used only when the memory
	  is small and the upgrade file is large. If you are not sure, select n by default.

config BSP_DISABLE_CONSOLE
	bool "disable console"
	default n
	help
	  The console in uboot is not secure. In formal commercial products,
	  the input and output of the console should be turned off to avoid being attacked.
	  Only during debugging, enable the input and output functions of the console.

config BSP_DISABLE_DOWNLOAD
	bool "disable chip download"
	default n
	help
	  The bare chip download programming function and the network download programming
	  function are not safe in a commercial environment and may be used by hackers.
	  Therefore, it needs to be disabled in the official product.

config DELAY_ENVIRONMENT
	bool "delay load environment"
	default n
	help
	  Normally the environment is loaded from flash when the board is
	  initialised so that it is available to U-Boot. This inhibits
	  that so that the environment in flash is not available until
	  explicitly loaded later by U-Boot code and U-Boot will use the
	  default environment which defined in code.
          It is recommended to set following configs if open DELAY_ENVIRONMENT:
	  USE_BOOTARGS and BOOTARGS and USE_BOOTCOMMAND and BOOTCOMMAND

config TIME_ADDR_OFFSET
	hex "record timestamp addr offset"
	default 0xC800
	help
		record the timestamp addr,base addr is fdt, TIME_ADDR_OFFSET is offset

endmenu

source "board/vendor/hi3519dv500/Kconfig"

source "board/vendor/hi3516cv610/Kconfig"

endif
```

## board/vendor/hi3516cv610/Kconfig
```kconfig
if TARGET_HI3516CV610_FAMILY

config SYS_VENDOR
	default "vendor"

config SYS_SOC
	default "hi3516cv610"

config SYS_BOARD
	default "hi3516cv610"

config SYS_CONFIG_NAME
	default "hi3516cv610"

endif
```

## board/vendor/hi3519dv500/Kconfig
```kconfig
if TARGET_HI3519DV500_FAMILY

config SYS_BOARD
	default "hi3519dv500"

config SYS_VENDOR
	default "vendor"

config SYS_SOC
	default "hi3519dv500"

config SYS_CONFIG_NAME
	default "hi3519dv500"

endif
```

## product/Kconfig
```kconfig
menu "Product"

source "product/ot_osd/Kconfig"
source "product/update/Kconfig"
source "product/security_subsys/Kconfig"
source "product/write_otp/scripts/Kconfig"
source "product/verify_boot/Kconfig"

endmenu
```

## product/update/Kconfig
```kconfig
config AUTO_UPDATE
	bool "auto update"
	select FS_FAT

config AUTO_SD_UPDATE
        bool "auto sd update"
	depends on AUTO_UPDATE
	default y if AUTO_UPDATE

config AUTO_SD_UPDATE_IS_IN_SDIO0
	bool "auto sd update is in sdio0"
	depends on AUTO_SD_UPDATE && !ENV_IS_IN_MMC
	default y

config AUTO_USB_UPDATE
        bool "auto usb update"
        select USB
	select USB_GADGET
	depends on AUTO_UPDATE
	default y if AUTO_UPDATE

config AUTO_UPDATE_ADAPTATION
	bool "auto update adaptation"
	depends on AUTO_UPDATE
	default y if AUTO_UPDATE
```

## product/verify_boot/Kconfig
```kconfig
config VERIFY_BOOT_ENABLE
	bool "verify boot enable"
    default n
    select SECURITY_SUBSYS_ENABLE
```

## product/write_otp/scripts/Kconfig
```kconfig
config WRITE_OTP_CMD
bool "writre otp cmd enable"
depends on SECURITY_SUBSYS_ENABLE
help
  writre otp cmd enable.
  
  The `write_otp` command by default does not burn (or program) any OTP.
  
  If you need to burn (or program) custom OTP according to the actual situation, you will need to:
  
  1. Open the `cmd_write_otp.c` file and find the two tables `g_otp_fields_big_endian_num` and `g_otp_fields_raw`.
  2. Fill in the OTP values to be programmed in the `g_otp_fields_big_endian_num` table. The `val` will be programmed in big-endian format to the corresponding position of OTP.
  3. Fill in the naked byte to be programmed in the `g_otp_fields_raw` table. The naked byte will be directly programmed into OTP.
  
  Note:
  1. The position of OTP is represented by a byte-bit tuple.
  2. OTP programming should be performed with caution. Once the programming is incorrect, it cannot be repaired.
  3. Be sure to back up OTP data to prevent data loss.
default n
```
